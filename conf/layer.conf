## conf/layer.conf
```bitbake
# Let bitbake find our .bbclass and .conf files
BBPATH .= ":${LAYERDIR}"

# Let bitbake know where to look for .bb and .bbappend files
BBFILES += "${LAYERDIR}/recipes-*/*/*.bb \
            ${LAYERDIR}/recipes-*/*/*.bbappend"

BBFILE_COLLECTIONS += "tibidabo"
BBFILE_PATTERN_tibidabo := "^${LAYERDIR}/"
BBFILE_PRIORITY_tibidabo = "6"
```

## conf/machine/tibidabo.conf
```bitbake
#@TYPE: Machine
#@NAME: ArchiTech Tibidabo board
#@SOC: i.MX6Q
#@DESCRIPTION: Machine configuration for ArchiTech Tibidabo board

require conf/machine/include/imx-base.inc
require conf/machine/include/tune-cortexa9.inc

SOC_FAMILY = "mx6:mx6q"

PREFERRED_PROVIDER_virtual/bootloader = "u-boot-fslc"
PREFERRED_VERSION_u-boot-fslc_mx6 = "v2014.01"
PREFERRED_PROVIDER_u-boot_mx6 = "u-boot-fslc"

UBOOT_CONFIG ??= "sd"
UBOOT_CONFIG[sd] = "tibidabo_config,sdcard"
IMAGE_BOOTLOADER ?= "u-boot"
do_rootfs[depends] += "tibidabo-bootscript-sd:do_deploy"
BOOT_SCRIPTS = "bootscript"

PREFERRED_PROVIDER_virtual/kernel = "linux-imx"
PREFERRED_VERSION_linux-imx = "3.10.53"
KERNEL_DEVICETREE = "imx6q-sabresd.dtb imx6q-sabresd-ldo.dtb imx6q-sabresd-hdcp.dtb imx6q-sabresd-enetirq.dtb imx6q-sabresd-uart.dtb"
KERNEL_IMAGETYPE = "zImage"
SERIAL_CONSOLE = "115200 ttymxc1"
MACHINE_FEATURES += " pci wifi bluetooth"
MACHINE_EXTRA_RRECOMMENDS_append = " kernel-modules"
```
